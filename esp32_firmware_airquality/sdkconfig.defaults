## esp32_firmware_airquality/sdkconfig.defaults
```kconfig
CONFIG_ESPTOOLPY_FLASHSIZE_4MB=y
CONFIG_ESPTOOLPY_FLASHSIZE="4MB"
CONFIG_SPIRAM=n
CONFIG_SPIRAM_BOOT_INIT=n
CONFIG_SPIRAM_IGNORE_NOTFOUND=y
CONFIG_ESP32_SPIRAM_SUPPORT=n 
CONFIG_SPIRAM_SUPPORT=n 
CONFIG_SPIRAM_USE_MALLOC=n
CONFIG_BT_ENABLED=y
CONFIG_BT_NIMBLE_ENABLED=y
CONFIG_PARTITION_TABLE_CUSTOM=y
CONFIG_PARTITION_TABLE_CUSTOM_FILENAME="partitions.csv"
CONFIG_ESP_WIFI_STA_DISCONNECTED_PM_ENABLE=n
CONFIG_WIFI_IRAM_OPT=n
CONFIG_WIFI_RX_IRAM_OPT=n

CONFIG_WIFI_IRAM_OPT=n
CONFIG_WIFI_RX_IRAM_OPT=n
CONFIG_ESP32_IRAM_AS_8BIT_ACCESSIBLE_MEMORY=n
CONFIG_BT_NIMBLE_NVS_PERSIST=n
CONFIG_NEWLIB_NANO_FORMAT=y

CONFIG_COMPILER_OPTIMIZATION_SIZE=y
CONFIG_ESP_SYSTEM_ESP32_SRAM1_REGION_AS_IRAM=y
```
